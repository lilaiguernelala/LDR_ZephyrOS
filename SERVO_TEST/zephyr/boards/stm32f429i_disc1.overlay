/ {
    servo: servo {
        compatible = "pwm-servo";
        pwms = <&pwm4 0 PWM_MSEC(20) PWM_POLARITY_NORMAL>;
        min-pulse = <PWM_USEC(700)>;
        max-pulse = <PWM_USEC(2500)>;
    };
};

&timers4 {
    status = "okay";
    st,prescaler = <1000>;

    pwm4: pwm {
        status = "okay";
        pinctrl-0 = <&tim4_ch4_pd15>;
        pinctrl-names = "default";
    };
};