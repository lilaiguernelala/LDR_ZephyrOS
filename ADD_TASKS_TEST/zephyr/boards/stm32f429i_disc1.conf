## ADD_TASKS_TEST/zephyr/boards/stm32f429i_disc1.conf
```kconfig
# Activate config to use the ILI9340 display with SPI interface
CONFIG_ILI9341=y
```

## ADD_TASKS_TEST/zephyr/modules/hc_sr04/dts/bindings/sensor/zephyr,hc-sr04.yaml
```yaml
# Copyright (c) 2020 Daniel Veilleux
# SPDX-License-Identifier: LicenseRef-BSD-5-Clause-Nordic

description: HC-SR04 Ultrasonic Ranging Module

compatible: "zephyr,hc-sr04"

include: base.yaml

properties:
  status:
    required: true
    type: string
    description: Human readable string describing the device's status

  trig-gpios:
    type: phandle-array
    description: Trigger pin
    required: true

  echo-gpios:
    type: phandle-array
    description: Echo pin
    required: true
```

## Samples/Sample/zephyr/boards/stm32f429i_disc1.conf
```kconfig
# Activate config to use the ILI9340 display with SPI interface
CONFIG_ILI9341=y

# Activate config to use the BME680 on I2C interface
CONFIG_I2C=y
#CONFIG_BME680=y
```
